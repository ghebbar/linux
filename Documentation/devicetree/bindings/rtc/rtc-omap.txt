## Documentation/devicetree/bindings/rtc/rtc-omap.txt
```
TI Real Time Clock

Required properties:
- compatible: "ti,da830-rtc"
- reg: Address range of rtc register set
- interrupts: rtc timer, alarm interrupts in order
- interrupt-parent: phandle for the interrupt controller

Optional properties:
- ti,system-power-controller: Telling whether or not rtc is controlling
  the system power.

Optional properties:
- ti,wakeup_capable: Inform the rtc driver that this module is wake-up
  capable so that rtcwake and suspend tests can work.
- ti,has_irq_wake_enb: Inform rtc driver that this module has a a
  special register to enable Wakeup feature for Alarm events.

Example:

rtc@1c23000 {
	compatible = "ti,da830-rtc";
	reg = <0x23000 0x1000>;
	interrupts = <19
		      19>;
	interrupt-parent = <&intc>;
	ti,system-power-controller;
};
```
